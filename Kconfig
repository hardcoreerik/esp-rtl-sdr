## Kconfig
```kconfig
menu "ESP_RTL_SDR-ESP"

    config ESP_RTL_SDR_ESP_ENABLED
        bool "Enable ESP_RTL_SDR-ESP driver"
        default y
        help
            USB Host client for official RTL-SDR Blog V4.

    config ESP_RTL_SDR_ESP_DEFAULT_TRANSFER_BYTES
        int "Default bulk transfer size (bytes)"
        default 16384
        range 512 262144
        help
            Gate 2 multi-URB default is 16384. Tab5 may override to 32768.

    config ESP_RTL_SDR_ESP_DEFAULT_TRANSFER_COUNT
        int "Default number of bulk buffers"
        default 6
        range 2 8

    config ESP_RTL_SDR_ESP_LOG_VERBOSE
        bool "Verbose driver logs"
        default n

endmenu
```

## examples/acquisition_probe/main/Kconfig.projbuild
```kconfig
menu "Customer-neutral acquisition probe"
config ESP_RTL_SDR_PROBE_RECEIVERS
    int "Receivers (built-in Waveshare hub supports up to three)"
    default 1
    range 1 3
config ESP_RTL_SDR_PROBE_DURATION_MS
    int "Acquisition validation duration (ms)"
    default 60000
    range 10000 1200000
endmenu
```

## examples/acquisition_probe/sdkconfig.defaults
```kconfig
CONFIG_ESP_MAIN_TASK_STACK_SIZE=8192
CONFIG_FREERTOS_HZ=1000
CONFIG_USB_HOST_CONTROL_TRANSFER_MAX_SIZE=1024
```

## examples/function_test/main/Kconfig.projbuild
```kconfig
menu "esp_rtl_sdr function test"

    config FT_MAX_DEVICES
        int "Handles to install (max dongles tested)"
        range 1 3
        default 3

    config FT_MIN_DEVICES
        int "Dongles that must be present (enumeration test fails below this)"
        range 0 3
        default 1

    config FT_SOAK_SECONDS
        int "Stream integrity / multi-device window (seconds)"
        range 2 600
        default 10

    config FT_LIFECYCLE_CYCLES
        int "start/stop cycles in the lifecycle test"
        range 1 200
        default 10

    config FT_BOOT_DELAY_MS
        int "Delay after install before testing, for enumeration (ms)"
        range 500 20000
        default 3000

    config FT_ALLOW_BIAS
        bool "Run bias-tee on/off test (SAFETY: only with nothing powered on the antenna port)"
        default n

    config FT_RUN_PASSPORT
        bool "Run on-device rate passport probe (slow)"
        default n

    config FT_INTERACTIVE
        bool "Run unplug/replug test (prompts the operator on the serial console)"
        default n

endmenu
```

## examples/p4_serial_smoke/main/Kconfig.projbuild
```kconfig
menu "esp_rtl_sdr p4_serial_smoke"

choice ESP_RTL_SDR_SMOKE_BOARD
    prompt "Board USB power profile (select explicitly)"
    default ESP_RTL_SDR_SMOKE_BOARD_UNKNOWN
    config ESP_RTL_SDR_SMOKE_BOARD_TAB5
        bool "M5Stack Tab5 (verify the power expander)"
    config ESP_RTL_SDR_SMOKE_BOARD_GENERIC
        bool "Other board (USB host power supplied by the board/application)"
    config ESP_RTL_SDR_SMOKE_BOARD_UNKNOWN
        bool "Unknown (USB power not verified)"
endchoice

choice ESP_RTL_SDR_SMOKE_URB
    prompt "USB bulk URB layout for quiet soak"
    default ESP_RTL_SDR_SMOKE_URB_6X16K
    help
        One layout per firmware image. Rebuild to A/B. Matches the fact that
        usb_host_uninstall is not a reliable re-entry on IDF 5.5.4 Tab5.

    config ESP_RTL_SDR_SMOKE_URB_6X16K
        bool "6 x 16 KiB (library default)"
    config ESP_RTL_SDR_SMOKE_URB_3X32K
        bool "3 x 32 KiB (OrcSDR-like)"
endchoice

config ESP_RTL_SDR_SMOKE_SOAK_MS
    int "Quiet soak duration (ms)"
    default 8000
    range 2000 60000

endmenu
```
